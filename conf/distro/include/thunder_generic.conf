## conf/distro/include/thunder_generic.conf
```bitbake
# FIXME: check wheter this is really needed
DISTRO_FEATURES_append = " compositor thunder"

# Make Thunder build types DISTRO_FEATURES, so other packages can use that if needed
DISTRO_FEATURES_append = " ${@bb.utils.contains('PACKAGECONFIG_pn-wpeframework', 'debug', 'thunder_debug', '', d)}"
DISTRO_FEATURES_append = " ${@bb.utils.contains('PACKAGECONFIG_pn-wpeframework', 'debugoptimized', 'thunder_debugoptimized', '', d)}"
DISTRO_FEATURES_append = " ${@bb.utils.contains('PACKAGECONFIG_pn-wpeframework', 'production', 'thunder_production', '', d)}"
DISTRO_FEATURES_append = " ${@bb.utils.contains('PACKAGECONFIG_pn-wpeframework', 'release', 'thunder_release', '', d)}"
DISTRO_FEATURES_append = " ${@bb.utils.contains('PACKAGECONFIG_pn-wpeframework', 'releasesymbols', 'thunder_releasesymbols', '', d)}"
```
